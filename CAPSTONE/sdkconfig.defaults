## CAPSTONE/sdkconfig.defaults
```kconfig
# ESP32-C3 Specific Configuration for CAPSTONE SecAgg Project
CONFIG_IDF_TARGET="esp32c3"
CONFIG_IDF_TARGET_ESP32C3=y

# Memory Optimization for ~400KB SRAM
CONFIG_ESP_MAIN_TASK_STACK_SIZE=3072
CONFIG_FREERTOS_IDLE_TASK_STACK_SIZE=1024
CONFIG_FREERTOS_TIMER_TASK_STACK_SIZE=2048
CONFIG_MBEDTLS_DYNAMIC_BUFFER=y
CONFIG_MBEDTLS_DYNAMIC_FREE_PEER_CERT=y
CONFIG_MBEDTLS_DYNAMIC_FREE_CONFIG_DATA=y
CONFIG_MBEDTLS_SSL_IN_CONTENT_LEN=4096
CONFIG_MBEDTLS_SSL_OUT_CONTENT_LEN=4096
CONFIG_MBEDTLS_SSL_MAX_FRAGMENT_LENGTH=4096
CONFIG_MBEDTLS_SSL_DTLS_CONNECTION_ID=y
CONFIG_MBEDTLS_SSL_KEEP_PEER_CERTIFICATE=n
CONFIG_MBEDTLS_SSL_VARIABLE_BUFFER_LENGTH=y

# Hardware Acceleration
CONFIG_MBEDTLS_SHA256_ALT=y
CONFIG_MBEDTLS_SHA256_SMALLER=y
CONFIG_MBEDTLS_HAVE_TIME=n
CONFIG_MBEDTLS_HAVE_TIME_DATE=n

# Disable unused features to save RAM/Flash
CONFIG_LOG_DEFAULT_LEVEL=3
CONFIG_LOG_MAXIMUM_LEVEL=3
CONFIG_VFS_SUPPORT_IO=n
CONFIG_VFS_SUPPORT_DIR=n
CONFIG_FATFS_USE_FASTSEEK=y
CONFIG_FATFS_CODEPAGE=437
CONFIG_FATFS_LONG_FILENAMES=y
CONFIG_FATFS_MAX_LFN=255
CONFIG_FATFS_API_ENCODING_UTF_8=y
CONFIG_FATFS_FS_LOCK=0
CONFIG_FATFS_TIMEOUT_MS=10000
CONFIG_FATFS_PER_FILE_CACHE=1

# WiFi Optimization
CONFIG_ESP_WIFI_STATIC_RX_BUFFER_NUM=4
CONFIG_ESP_WIFI_DYNAMIC_RX_BUFFER_NUM=8
CONFIG_ESP_WIFI_TX_BUFFER_TYPE=1
CONFIG_ESP_WIFI_DYNAMIC_TX_BUFFER_NUM=8
CONFIG_ESP_WIFI_CSI_ENABLED=n
CONFIG_ESP_WIFI_AMPDU_TX_ENABLED=y
CONFIG_ESP_WIFI_AMPDU_RX_ENABLED=y
CONFIG_ESP_WIFI_NVS_ENABLED=n
CONFIG_ESP_WIFI_TASK_PINNED_TO_CORE_0=y
CONFIG_ESP_WIFI_SOFTAP_BEACON_MAX_LEN=752
CONFIG_ESP_WIFI_MGMT_SBUF_NUM=8

# lwIP Optimization
CONFIG_LWIP_MAX_SOCKETS=6
CONFIG_LWIP_TCP_MSL=60000
CONFIG_LWIP_TCP_SND_BUF_DEFAULT=5744
CONFIG_LWIP_TCP_WND_DEFAULT=5744
CONFIG_LWIP_TCP_RECVMBOX_SIZE=6
CONFIG_LWIP_UDP_RECVMBOX_SIZE=6
CONFIG_LWIP_TCP_ACCEPTMBOX_SIZE=6

# NVS
CONFIG_NVS_ENCRYPTION=n
CONFIG_NVS_SECURITY=n

# Disable Debug/Profiling
CONFIG_APPTRACE_DESTINATION_NONE=y
CONFIG_APPTRACE_ONPANIC_HOST_FLUSH_TMO=1000
CONFIG_GCOV_ENABLE=n
CONFIG_CXX_EXCEPTIONS=n
CONFIG_CXX_RTTI=n

# Heap Poisoning (disabled for production performance)
CONFIG_HEAP_POISONING_DISABLED=y
CONFIG_HEAP_TRACING_OFF=y

# Task Watchdog
CONFIG_ESP_TASK_WDT_TIMEOUT_S=30
CONFIG_ESP_TASK_WDT_CHECK_IDLE_TASK_CPU0=n
CONFIG_ESP_INT_WDT_TIMEOUT_MS=30000

# Panic Handler
CONFIG_ESP_SYSTEM_PANIC_SILENT_REBOOT=y
CONFIG_ESP_SYSTEM_PANIC_PRINT_REBOOT=n
CONFIG_ESP_SYSTEM_PANIC_GDBSTUB=n

# Brownout
CONFIG_ESP_BROWNOUT_DET=y
CONFIG_ESP_BROWNOUT_DET_LVL_SEL_7=y

# Partition Table
CONFIG_PARTITION_TABLE_SINGLE_APP=y
CONFIG_PARTITION_TABLE_OFFSET=0x8000
```
